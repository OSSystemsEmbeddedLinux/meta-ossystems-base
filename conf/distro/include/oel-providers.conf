## conf/distro/oel-tiny.conf
```bitbake
# Distribution definition for: oel-tiny
#
# Copyright (c) 2011, Intel Corporation.
# Copyright (c) 2016, 2017 O.S. Systems Software LTDA.
# All rights reserved.
#
# This file is released under the MIT license as described in
# ../meta/COPYING.MIT.
#
# oel-tiny is intended to define a tiny Linux system comprised of a
# Linux kernel tailored to support each specific MACHINE and busybox.
# oel-tiny sets some basic policy to ensure a usable system while still
# keeping the rootfs and kernel image as small as possible.
#
# The policies defined are intended to meet the following goals:
# o Serial consoles only (no framebuffer or VGA console)
# o Basic support for IPV4 networking
# o Single user ash shell
# o Static images (no support for adding packages or libraries later)
# o Read-only or RAMFS root filesystem
# o Combined Linux kernel + rootfs in under 4MB

require conf/distro/include/oel.inc

DISTRO = "oel-tiny"
DISTRO_NAME = "O.S. Systems Embedded Linux Tiny"

TCLIBC = "musl"
DISTROOVERRIDES = "oel:oel-tiny"

# Distro config is evaluated after the machine config, so we have to explicitly
# set the kernel provider to override a machine config.
PREFERRED_PROVIDER_virtual/kernel ?= "linux-yocto-tiny"
PREFERRED_VERSION_linux-yocto-tiny ?= "6.18%"

OEL_DEFAULT_EXTRA_RRECOMMENDS = ""

# Disable wide char support for ncurses as we don't include it in
# in the LIBC features below.
# Leave native enable to avoid build failures
ENABLE_WIDEC = "false"
ENABLE_WIDEC:class-native = "true"

# Drop native language support to avoid pulling gettext and wide-char libc
# features into the tiny image.
USE_NLS="no"

# DISTRO_FEATURES options:
# alsa bluetooth ext2 irda pcmcia usbgadget usbhost wifi nfs zeroconf pci
DISTRO_FEATURES_TINY = "pci"
DISTRO_FEATURES_NET = "ipv4 ipv6"
DISTRO_FEATURES_USB = "usbhost"
#DISTRO_FEATURES_USBGADGET = "usbgadget"
#DISTRO_FEATURES_WIFI = "wifi"

DISTRO_FEATURES = " \
    ${DISTRO_FEATURES_TINY} \
    ${DISTRO_FEATURES_NET} \
    ${DISTRO_FEATURES_USB} \
    ${DISTRO_FEATURES_USBGADGET} \
    ${DISTRO_FEATURES_WIFI} \
"

DISTRO_FEATURES:class-native = "${DISTRO_FEATURES_DEFAULTS} ${OEL_DEFAULT_DISTRO_FEATURES}"
DISTRO_FEATURES:class-nativesdk = "${DISTRO_FEATURES_DEFAULTS} ${OEL_DEFAULT_DISTRO_FEATURES}"

# Use tmpdevfs and the busybox runtime services
VIRTUAL-RUNTIME_dev_manager = ""
VIRTUAL-RUNTIME_login_manager = ""
VIRTUAL-RUNTIME_init_manager = "tiny-init-system"
VIRTUAL-RUNTIME_keymaps = ""

# By default we only support initramfs. We don't build live as that
# pulls in a lot of dependencies for the live image and the installer, like
# udev, grub, etc.  These pull in gettext, which fails to build with wide
# character support.
IMAGE_FSTYPES ??= "cpio.gz"

QB_DEFAULT_FSTYPE = "${IMAGE_FSTYPES}"

# Drop v86d from qemu dependency list (we support serial)
# Drop grub from meta-intel BSPs
MACHINE_ESSENTIAL_EXTRA_RDEPENDS = ""

SKIP_RECIPE[build-appliance-image] = "not buildable with oel-tiny"
SKIP_RECIPE[core-image-base] = "not buildable with oel-tiny"
SKIP_RECIPE[core-image-full-cmdline] = "not buildable with oel-tiny"
SKIP_RECIPE[core-image-rt] = "not buildable with oel-tiny"
SKIP_RECIPE[core-image-rt-sdk] = "not buildable with oel-tiny"
SKIP_RECIPE[core-image-sato] = "not buildable with oel-tiny"
SKIP_RECIPE[core-image-sato-dev] = "not buildable with oel-tiny"
SKIP_RECIPE[core-image-sato-sdk] = "not buildable with oel-tiny"
SKIP_RECIPE[core-image-x11] = "not buildable with oel-tiny"
SKIP_RECIPE[core-image-weston] = "not buildable with oel-tiny"

# Disable python usage in opkg-utils since it won't build with tiny config
PACKAGECONFIG:remove:pn-opkg-utils = "python"
```

## conf/distro/oel.conf
```bitbake
# WARNING: the order of include/require/settings in this file is
# important!

# We used to use Poky for the infrastructure of projects.  Now we use
# openembedded-core.  This include is for compatibility with projects
# that rely on Poky.
include conf/distro/poky.conf

require conf/distro/include/oel.conf

DISTRO = "oel"
DISTRO_NAME = "O.S. Systems Embedded Linux"
```

## conf/layer.conf
```bitbake
# We have a conf and classes directory, add to BBPATH
BBPATH .= ":${LAYERDIR}"

# We have a packages directory, add to BBFILES
BBFILES += "${LAYERDIR}/recipes-*/*/*.bb \
            ${LAYERDIR}/recipes-*/*/*.bbappend"

BBFILE_COLLECTIONS += "ossystems-base"
BBFILE_PATTERN_ossystems-base := "^${LAYERDIR}/"
BBFILE_PRIORITY_ossystems-base = "8"

LAYERSERIES_COMPAT_ossystems-base = "honister"

LICENSE_PATH += "${LAYERDIR}/conf/licenses"

SIGGEN_EXCLUDERECIPES_ABISAFE += "easysplash-config"
```
